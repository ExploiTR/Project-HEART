#include <Arduino.h>
#include <ArduinoOTA.h>
#include "SSD1306Wire.h"
#include "WiFiManager.h"

void disp(String str);
void sensors_or_commands(WiFiClient client);
void engageOTA();
void configModeCallback(WiFiManager *myWiFiManager);

String ssid = "Linksys | Time";
String password = "Hacking%$%Failed";

WiFiServer server(188);
SSD1306Wire display(0x3c, D7, D6);

int READ_ECG_PIN_LOW_M = D0;
int READ_ECG_PIN_LOW_P = D1;
int READ_ECG_OR_BEAT_PIN_OUT = A0;

uint8_t Y_LOC = 0;

const unsigned char bmp[] PROGMEM = {
    0x00, 0x00, 0x00, 0x00, 0x00, 0x00, 0x00, 0x00, 0x00, 0x00, 0x00, 0x00, 0x00, 0x00, 0x00, 0x00,
    0x00, 0x00, 0x00, 0x00, 0x00, 0x00, 0x00, 0x00, 0x00, 0x00, 0x00, 0x00, 0x00, 0xe0, 0xf8, 0xfe,
    0xfe, 0xfe, 0xfc, 0xf0, 0xc0, 0x00, 0x00, 0x00, 0x00, 0x00, 0x00, 0x00, 0x00, 0x00, 0x00, 0x00,
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    0x03, 0x0f, 0x1f, 0x1f, 0x1f, 0x1f, 0x1f, 0x1f, 0x1f, 0x1f, 0x1f, 0x1f, 0x18, 0x00, 0x00, 0x00};

void setup()
{
    display.init();
    display.flipScreenVertically();
    display.clear();
    display.drawFastImage(0, 0, 128, 64, bmp);
    display.display();

    server.begin();

    WiFiManager wifiManager;
    wifiManager.setAPCallback(configModeCallback);

    if (!wifiManager.autoConnect("connect...."))
    {
        disp("Trying manual connect..");
        WiFi.begin(ssid, password);
        WiFi.mode(WIFI_STA);

        if (WiFi.waitForConnectResult() != WL_CONNECTED)
        {
            disp("Resetting ESP...");
            delay(500);
            ESP.reset();
            delay(1000);
        }
    }

    pinMode(LED_BUILTIN, OUTPUT);
    digitalWrite(LED_BUILTIN, HIGH);
    delay(500);
    digitalWrite(LED_BUILTIN, LOW);

    display.clear();
    disp("Connect to : " + WiFi.localIP().toString() + ":188");
    engageOTA();
}

void loop()
{
    WiFiClient client = server.available(); // Listen for incoming clients
    ArduinoOTA.handle();
    sensors_or_commands(client);
}

void engageOTA()
{
    ArduinoOTA.onStart([]()
                       { disp("Receiving update"); });
    ArduinoOTA.onEnd([]()
                     { ESP.restart(); });
    ArduinoOTA.onProgress([](unsigned int progress, unsigned int total)
                          { disp(String((progress / (total / 100))) + "%"); });
    ArduinoOTA.onError([](ota_error_t error)
                       {
        disp("FAILED! Restarting");
        delay(500);
        ESP.restart(); });
    ArduinoOTA.begin();
}

void configModeCallback(WiFiManager *myWiFiManager)
{
    disp("Entered config mode\n");
    disp(WiFi.softAPIP().toString());
    disp(myWiFiManager->getConfigPortalSSID());
}

void sensors_or_commands(WiFiClient client)
{
    if (client)
    {
        while (client.connected())
        {
            client.print(digitalRead(READ_ECG_PIN_LOW_P) == 1 || digitalRead(READ_ECG_PIN_LOW_M) == 1 ? "-1\n" : String(analogRead(READ_ECG_OR_BEAT_PIN_OUT)) + "\n");
            delay(8); // 125hz
        }
        client.stop();
    }
}

void disp(String text)
{
    if (Y_LOC > 50)
    {
        Y_LOC = 0;
        display.clear();
    }
    display.drawString(0, Y_LOC += 10, text);
    display.display();
}
