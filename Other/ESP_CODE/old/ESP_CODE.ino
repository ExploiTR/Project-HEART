#include <ArduinoJson.h>
#include <ESP8266WiFi.h>
#include <ESP8266mDNS.h>
#include <WiFiUdp.h>
#include <ArduinoOTA.h>
#include <Wire.h>
#include "SSD1306Wire.h"
#include <EEPROM.h>

String ssid = "Linksys | Time";
String password = "Hacking%$%Failed"; //save memory with progmem
String config_hbr = "config_server";

WiFiServer server(188);
SSD1306Wire display(0x3c, D7, D6);

int READ_ECG_PIN_LOW_M = D0;
int READ_ECG_PIN_LOW_P = D1;
int READ_ECG_OR_BEAT_PIN_OUT = A0;

uint8_t Y_LOC = 0;

const unsigned char bmp [] PROGMEM = {
  0x00, 0x00, 0x00, 0x00, 0x00, 0x00, 0x00, 0x00, 0x00, 0x00, 0x00, 0x00, 0x00, 0x00, 0x00, 0x00, 
  0x00, 0x00, 0x00, 0x00, 0x00, 0x00, 0x00, 0x00, 0x00, 0x00, 0x00, 0x00, 0x00, 0xe0, 0xf8, 0xfe, 
  0xfe, 0xfe, 0xfc, 0xf0, 0xc0, 0x00, 0x00, 0x00, 0x00, 0x00, 0x00, 0x00, 0x00, 0x00, 0x00, 0x00, 
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  0x03, 0x0f, 0x1f, 0x1f, 0x1f, 0x1f, 0x1f, 0x1f, 0x1f, 0x1f, 0x1f, 0x1f, 0x18, 0x00, 0x00, 0x00
};

void setup() {
    display.init();
    display.flipScreenVertically();
    display.clear();
    display.drawFastImage(0, 0, 128, 64, bmp);
    display.display();

    server.begin();
    EEPROM.begin(512);

    String ssid_eep = GETMEM(0,32).c_str();
    String pass_eep = GETMEM(32,64).c_str();
    WiFi.begin(ssid,password);
    WiFi.mode(WIFI_STA);

    if (WiFi.waitForConnectResult() != WL_CONNECTED) {
        disp("Can't connect! Starting config open AP "+ config_hbr);
        startAp();
    }

    pinMode(LED_BUILTIN,OUTPUT);
    digitalWrite(LED_BUILTIN,HIGH);
    delay(500);
    digitalWrite(LED_BUILTIN,LOW);
   // pinMode(LED_BUILTIN,INPUT);

    display.clear();
    disp("Connect to : " + WiFi.localIP().toString() + ":188");
    engageOTA();
}

void loop() {
    WiFiClient client = server.available();   // Listen for incoming clients
    ArduinoOTA.handle();
    sensors_or_commands(client);
}

void engageOTA() {
    ArduinoOTA.onStart([]() {
        disp("Receiving update");
    });
    ArduinoOTA.onEnd([]() {
        ESP.restart();
    });
    ArduinoOTA.onProgress([](unsigned int progress, unsigned int total) {
        disp(String((progress / (total / 100))) + "%");
    });
    ArduinoOTA.onError([](ota_error_t error) {
        disp("FAILED! Restarting");
        delay(500);
        ESP.restart();
    });
    ArduinoOTA.begin();
}

void sensors_or_commands(WiFiClient client) {
    if (client) {
        while (client.connected() ) {
            client.print(digitalRead(READ_ECG_PIN_LOW_P) == 1 || digitalRead(READ_ECG_PIN_LOW_M) == 1 ? "-1\n" : String(analogRead(READ_ECG_OR_BEAT_PIN_OUT)) + "\n");
            delay(8); //125hz
        }
        client.stop();
    }
}

void startAp() {
    //todo
    WiFi.softAP(config_hbr);
    WiFiClient client = server.available();
    if (client) {
        while (client.connected()) {
            if (client.available())
            {
                //like "{\"sensor\":\"gps\",\"time\":1351824120,\"data\":[48.756080,2.302038]}"
                String line = client.readStringUntil('\r');
                if(line == "ready\r")
                {
                    client.println("ready\r");
                }
                if (line.length() >1)
                {
                    DynamicJsonDocument doc(256);
                    deserializeJson(doc, line);
                    const char* ssid = doc["ssi"];
                    const char* pass = doc["pas"];

                    SAVEMEM(ssid,0);
                    SAVEMEM(pass,32);
                    client.println("ack\r");
                    disp("Rebooting....");
                    delay(500);
                    //ESP.restart();
                }
            }
        }
        client.stop();
    }
}

void disp(String text) {
    if(Y_LOC > 50) {
        Y_LOC = 0;
        display.clear();
    }
    display.drawString(0,Y_LOC+=10,text);
    display.display();
}

void SAVEMEM(String text, int start_addr) {
    for (int L = 0; L < 32; ++L) {
        EEPROM.write(start_addr + L, text[L]);
    }
    EEPROM.commit();
}

String GETMEM(int start_addr, int end_addr) {
    String buffer;
    for (int L = start_addr; L < end_addr; ++L)
        if (isAlphaNumeric(EEPROM.read(L)))
            buffer += char(EEPROM.read(L));
    return buffer;
}
